#ifndef __CHALLENGES_H__
#define __CHALLENGES_H__

#include <EEPROM.h>

#include "applet.h"

//
// special font table for challenge
//
static const uint8_t challengefont[][5] = {
{0x00, 0x40, 0x40, 0x40, 0x40}, // ' '
{0x00, 0x82, 0x44, 0x28, 0x10},
{0x7e, 0x04, 0x08, 0x04, 0x7e},
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{0x40, 0x40, 0x40, 0x40, 0x7e}, // ~
};

const uint8_t answers[][6] = {
  {0x7c, 0x15, 0xd6, /*...*/  0x35, 0x69, 0x69}, // catch me
  {0x28, 0x1c, 0x5e, /*...*/  0x9b, 0x4a, 0x1d}, // crypto
  {0xb8, 0x4d, 0x67, /*...*/  0x10, 0x68, 0xe4}, // pigs
  {0x03, 0x13, 0x37, /*...*/  0x03, 0x13, 0x37}, // dino
};

class Challenge1 : public Applet {
  public:
  static const char txtMsg[]; // see cpp file
  static const int flaglen = 19;

  Challenge1() {
    bool idxSeen[flaglen];

    for (int i = 0; i < flaglen; i++)
      idxSeen[i] = false;

    for (int i = 0; i < flaglen - 3; ) {
      int r = random(0, flaglen);

      // check number wasn't used
      if (! idxSeen[r]) {
        sequence[i] = r;
        idxSeen[r] = true;
        i++; // move to pick next random number
      } else {
        // redo loop to pick a new number
      }
    }

    // last 3 numbers just pick whatever's not there
    for (int i = flaglen - 3; i < flaglen; i++) {
      for (int j = 0; j < flaglen; j++) {
        if (! idxSeen[j]) {
          sequence[i] = j;
          idxSeen[j] = true;
          break;
        }
      }
    }

    pos = 1;
    prevPos = 0;
    lastDrawn = millis();

    LcdClear();

    //for (int i = 0; i < flaglen; i++) {
    //   Serial.print(i); Serial.print(" "); Serial.println(sequence[i]);
    //}
  }

  virtual void loop();
  virtual void keypress(Applet::Key key);

  protected:
  long lastDrawn;
  int pos, prevPos;
  int sequence[flaglen];
  char flaginput[32 + 1];
};

class Challenge2 : public Applet {
  public:
  virtual void loop();
  virtual void keypress(Applet::Key key);

  protected:
  char flaginput[32 + 1];
};

class Challenge3 : public Applet {
  public:
  virtual void loop();
  virtual void keypress(Applet::Key key);

  protected:
  char flaginput[32 + 1];
};


class BossLevel : public Applet {
  public:
  BossLevel(uint8_t *key) {
    memcpy(this->key, key, 16);
  }

  virtual void loop();
  virtual void keypress(Applet::Key key);

  protected:
  uint8_t key[16];
};

#endif
